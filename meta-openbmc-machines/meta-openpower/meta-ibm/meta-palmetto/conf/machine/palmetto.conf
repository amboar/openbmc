## meta-openbmc-machines/meta-openpower/meta-ibm/meta-palmetto/conf/machine/palmetto.conf
```bitbake
KMACHINE = "aspeed"
KERNEL_DEVICETREE = "${KMACHINE}-bmc-opp-${MACHINE}.dtb"

require conf/machine/include/ast2400.inc
require conf/machine/include/obmc-bsp-common.inc
require conf/machine/include/ibm.inc

UBOOT_MACHINE_palmetto = "ast_g4_config"
UBOOT_ENTRYPOINT = "0x40008000"
UBOOT_LOADADDRESS = "0x40008000"

FLASH_SIZE = "32768"

QEMU_BOOT_SUPPORTED = "1"

QEMU_MEM = "-m 512"
QEMU_MAHINE_SUBTYPE = "-machine ${MACHINE}-bmc"
QEMU_DEFAULT_FSTYPE="raw"
QEMU_KERNEL_OPTIONS = "console=ttyS4 earlyprintk"
QEMU_ROOTFS="${DEPLOY_DIR_IMAGE}/flash-palmetto"
QEMU_UI_OPTIONS = ""
```
